## application/edge_agent/boards/espressif/esp32_S3_DevKitC_1/sdkconfig.defaults.board
```kconfig
CONFIG_NETWORK_BACKEND_WIFI=y
CONFIG_MBEDTLS_CERTIFICATE_BUNDLE_DEFAULT_FULL=y
CONFIG_ESP_TLS_INSECURE=y
CONFIG_ESP_TLS_SKIP_SERVER_CERT_VERIFY=y
CONFIG_ESP_TASK_WDT_TIMEOUT_S=30
CONFIG_MBEDTLS_ECP_RESTARTABLE=y
CONFIG_SPI_CAM_BRIDGE_ENABLE=y
CONFIG_APP_CLAW_CAP_IM_TG=n
CONFIG_SPI_WIZ_CLOCK_HZ=2000000
CONFIG_ESP_DEFAULT_CPU_FREQ_MHZ_240=y
CONFIG_ESPTOOLPY_FLASHMODE_QIO=y
CONFIG_ESPTOOLPY_FLASHFREQ_80M=y
CONFIG_ESPTOOLPY_FLASHSIZE_8MB=y
CONFIG_SPIRAM=y
CONFIG_SPIRAM_MODE_OCT=y
CONFIG_SPIRAM_SPEED_80M=y
```

## application/edge_agent/main/Kconfig.projbuild
```kconfig
menu "Network Backend"
    choice NETWORK_BACKEND
        prompt "Network backend"
        default NETWORK_BACKEND_WIFI
        config NETWORK_BACKEND_WIFI
            bool "WiFi (default)"
        config NETWORK_BACKEND_WIRED
            bool "Wired via W55RP20 SPI"
    endchoice
endmenu

menu "SPI Camera Bridge"
    config SPI_CAM_BRIDGE_ENABLE
        bool "Enable SPI camera bridge to Pico (JPEG via custom SPI protocol)"
        default y if NETWORK_BACKEND_WIRED
        default n
        help
            Send JPEG frames to Pico/WIZnet over a custom PING/CHUNK SPI protocol.
            Can be combined with either WiFi or Wired network backend.
            Camera capture (SPI_CMD_CAPTURE_REQ) requires ESP_BOARD_DEV_CAMERA_SUPPORT;
            other bridge commands (PING/PONG, LUA_EXEC, GPIO_SET) work without camera.

    if SPI_CAM_BRIDGE_ENABLE
        config SPI_WIZ_SCK_IO
            int "SPI SCK GPIO"
            default 7
        config SPI_WIZ_MISO_IO
            int "SPI MISO GPIO"
            default 8
        config SPI_WIZ_MOSI_IO
            int "SPI MOSI GPIO"
            default 9
        config SPI_WIZ_CS_IO
            int "SPI CS GPIO"
            default 1
        config SPI_WIZ_IRQ_IO
            int "IRQ GPIO (Pico→ESP32, active-high during slave TX)"
            default 2
        config SPI_WIZ_CLOCK_HZ
            int "SPI clock Hz"
            default 2000000

        config PERSON_DETECT_ENABLE
            bool "Enable on-device TFLite person detection"
            default y
            depends on ESP_BOARD_DEV_CAMERA_SUPPORT
            help
                Run MobileNet-based person detection (96x96 grayscale, int8) on every
                PIR-triggered capture. If no person is detected the capture is discarded
                and neither Vision API nor Telegram are called, saving quota and bandwidth.
                Requires esp-tflite-micro managed component (~200 KB PSRAM tensor arena).

        config PERSON_DETECT_THRESHOLD
            int "Person detection confidence threshold (%)"
            range 10 90
            default 50
            depends on PERSON_DETECT_ENABLE
            help
                Minimum person confidence score (0-100) required to proceed with
                Vision API and Telegram alert. Lower values = more sensitive (more
                false positives); higher values = stricter (may miss distant persons).
    endif
endmenu

menu "App Config"

menu "Default Wi-Fi Settings"

    config APP_WIFI_SSID
        string "Default Wi-Fi SSID"
        default ""
        help
            Default Wi-Fi SSID used to populate app settings.

    config APP_WIFI_PASSWORD
        string "Default Wi-Fi password"
        default ""
        help
            Default Wi-Fi password used to populate app settings.

    config APP_WIFI_AP_SSID_PREFIX
        string "Provisioning AP SSID prefix"
        default "esp-claw"
        help
            Prefix used to build the unique provisioning AP SSID. The full
            SSID is "<prefix>-<MAC[3..5]>" (e.g. esp-claw-84AEE5).

    config APP_WIFI_AP_CHANNEL
        int "Provisioning AP channel"
        range 1 13
        default 1
        help
            Channel used by the provisioning SoftAP.

    config APP_WIFI_AP_MAX_CONN
        int "Provisioning AP max connections"
        range 1 10
        default 4
        help
            Maximum number of concurrent stations on the provisioning AP.

    config APP_WIFI_MAX_RETRY
        int "STA max retries before AP fallback"
        range 1 20
        default 5
        help
            After this many consecutive STA connection failures the device
            falls back to pure AP mode and waits for the user to provision
            new credentials.

endmenu

menu "Default Search Settings"

    config APP_SEARCH_HTTP_ALLOWLIST
        string "Default HTTP Request allowlist"
        default "*"
        help
            Default value used to populate app setting `search_http_allowlist`.
            Use `*` to allow all hosts, or a comma-separated list of domains/IPs.

            e.g. "api.example.com,*.example.org,203.0.113.10"

endmenu

menu "Wired Guardian Test Hooks"

    config CLAW_GUARDIAN_HANG_TEST_HOOK
        bool "Enable Guardian HUNG regression test hook"
        default n
        help
            When enabled, an incoming LLM_REQ whose text contains "__hang__"
            is silently swallowed (never submitted, never answered) instead
            of processed normally, while the SPI status heartbeat keeps
            flowing. This simulates a logically-hung agent (RTOS alive, agent
            stuck) so the W55RP20 Guardian's HUNG detection and reset-line
            recovery can be regression-tested on demand.

            Leave disabled in any build reachable from a real Telegram bot —
            an unconditional trigger string would let anyone hang the agent
            (and eventually force an ESP reset) just by sending that phrase.

endmenu

endmenu
```
